## external/Config.in
```kconfig
menu "roc-audio-conv external"
    source "$BR2_EXTERNAL_ROC_AUDIO_CONV_PATH/package/rtl8xxxu/Config.in"
    source "$BR2_EXTERNAL_ROC_AUDIO_CONV_PATH/package/roc-toolkit/Config.in"
endmenu
```

## external/package/roc-toolkit/Config.in
```kconfig
config BR2_PACKAGE_ROC_TOOLKIT
    bool "roc-toolkit (audio over IP)"
    help
      roc-streaming/roc-toolkit built via scons, installed under /usr.
```

## external/package/rtl8xxxu/Config.in
```kconfig
config BR2_PACKAGE_RTL8XXXU
    bool "rtl8xxxu (out-of-tree kernel module)"
    help
      Realtek 8xxxu USB Wi-Fi driver from lwfinger/rtl8xxxu.
```
